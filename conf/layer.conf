## conf/layer.conf
```bitbake
# We have a conf and classes directory, add to BBPATH
BBPATH .= ":${LAYERDIR}"

# We have recipes-* directories, add to BBFILES
BBFILES += "${LAYERDIR}/recipes-*/*/*.bb \
            ${LAYERDIR}/recipes-*/*/*.bbappend"

BBFILE_COLLECTIONS += "abc"
BBFILE_PATTERN_abc = "^${LAYERDIR}/"
BBFILE_PRIORITY_abc = "7"
LAYERVERSION_abc = "1"
LAYERSERIES_COMPAT_abc = "scarthgap"
```
